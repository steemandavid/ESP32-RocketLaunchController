## main/Kconfig.projbuild
```kconfig
menu "Rocket Launch Controller"

    choice RLC_UNIT_TYPE
        prompt "Unit type"
        default RLC_UNIT_BASE
        help
            Select whether to build firmware for the Base unit or the Remote unit.

        config RLC_UNIT_BASE
            bool "Base Unit"
            help
                Build firmware for the base (launch pad) unit.

        config RLC_UNIT_REMOTE
            bool "Remote Unit"
            help
                Build firmware for the remote (operator) unit.
    endchoice

    config RLC_FAULT_INJECTION
        bool "Fault injection console (TEST BUILDS ONLY - base unit)"
        default n
        depends on RLC_UNIT_BASE
        help
            Adds a UART0 console that can deliberately withhold STATUS_UPDATE
            and emit a wrong channel in an ARM ACK, to exercise FSD tests
            T-A11 and T-A13. Neither can be induced from outside the firmware:
            link loss trips at 1.5 s, well before the 5 s staleness timeout, so
            "linked but stale" is unreachable by interfering with the radio;
            and nothing in normal operation emits a malformed ACK.

            A firmware built with this option DELIBERATELY LIES TO THE REMOTE
            and is NOT SAFE FOR LIVE USE. The build emits a #warning and the
            running firmware prints a banner at boot. Leave this off.

    config RLC_REMOTE_FAULT_INJECTION
        bool "Fault injection console (TEST BUILDS ONLY - remote unit)"
        default n
        depends on RLC_UNIT_REMOTE
        help
            Adds a UART0 console that can drive the remote into a terminal
            ERROR on a keystroke, exercising the REMOTE FAULT status-band
            state and the ERROR screen behind it.

            Those are latched by exactly four conditions - remote battery
            critical, display fault, multi-arm detected, and a boot failure -
            and none can be produced from the base harness or from the air.
            Reaching them for real means pulling the display flex on a live
            remote or flattening the pack.

            A firmware built with this option can FAULT ITSELF ON DEMAND and
            is NOT SAFE FOR LIVE USE. The build emits a #warning and the
            running firmware prints a banner at boot. Leave this off.

    config RLC_SERIAL_DEBUG_LOGGING
        bool "Enable serial debug logging"
        default y
        help
            Enable UART0 log output at runtime. When disabled, no serial
            logging is produced (field operation mode).

endmenu
```
